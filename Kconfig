## Kconfig
```kconfig
config CHIPTUNER_BEHAVIOR_TONE
    bool "Chiptuner Tone Behavior"
    default y
    depends on DT_HAS_CHIPTUNER_BEHAVIOR_TONE_ENABLED && PWM
```

## dts/bindings/behaviors/chiptuner,behavior-tone.yaml
```yaml
# Copyright (c) 2024 The ZMK Contributors
# SPDX-License-Identifier: MIT

description: Tone Behavior

compatible: "chiptuner,behavior-tone"

include: one_param.yaml

properties:
  pwms:
    required: true
    type: phandle-array
    description: |
      Reference to a PWM instance.
```
